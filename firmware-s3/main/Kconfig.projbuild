## firmware-s3/main/Kconfig.projbuild
```kconfig
menu "AS120 Configuration"
    config SIMULATE_I2C
        bool "Simulate I2C devices (no PCB required)"
        default n
        help
            When enabled, all I2C communication is simulated.
            The TCA9535 GPIO expanders and DAC7574 DACs will not
            be accessed on the I2C bus, and home switch inputs
            will be simulated. This allows running the firmware
            on a bare ESP32-S3 devkit without the PCB attached.
endmenu
```

## firmware-s3/sdkconfig.defaults
```kconfig
# Target: ESP32-S3
CONFIG_IDF_TARGET="esp32s3"

# Use 240 MHz CPU frequency
CONFIG_ESP_DEFAULT_CPU_FREQ_MHZ_240=y

# UART1 for logging output (RS-232 debug jack)
CONFIG_ESP_CONSOLE_UART_NUM=1
CONFIG_ESP_CONSOLE_UART_BAUDRATE=115200

# Enable NVS
CONFIG_NVS_ENCRYPTION=n

# Custom partition table
CONFIG_PARTITION_TABLE_CUSTOM=y
CONFIG_PARTITION_TABLE_CUSTOM_FILENAME="partitions.csv"

# WiFi
CONFIG_ESP_WIFI_ENABLED=y

# BLE (NimBLE)
CONFIG_BT_ENABLED=y
CONFIG_BT_NIMBLE_ENABLED=y
CONFIG_BT_NIMBLE_MAX_CONNECTIONS=3
CONFIG_BT_NIMBLE_ATT_PREFERRED_MTU=512

# SPIFFS
CONFIG_SPIFFS_MAX_PARTITIONS=1

# HTTP Server
CONFIG_HTTPD_MAX_REQ_HDR_LEN=1024
CONFIG_HTTPD_MAX_URI_LEN=512

# Increase main task stack for all subsystems
CONFIG_ESP_MAIN_TASK_STACK_SIZE=32768
```
